## apps/FlightComputer/StateMachine/Kconfig
```kconfig
config FLIGHTCOMPUTER_STATEMACHINE
        tristate "Flight Computer State Machine"
        default n
        ---help---
                Enable the Flight Computer

if FLIGHTCOMPUTER_STATEMACHINE

choice
    prompt "Select Flight Computer Type"
    default FLIGHTCOMPUTER_STATEMACHINE_STMFC

    config FLIGHTCOMPUTER_STATEMACHINE_STMFC
        bool "STMFC"
        help
            Select this option for the STM Flight Computer specific features.

endchoice

config FLIGHTCOMPUTER_STATEMACHINE_PROGNAME
        string "Program name"
        default "FC_StateMachine"
        ---help---
                This is the name of the program that will be used when the NSH ELF
                program is installed.

config FLIGHTCOMPUTER_STATEMACHINE_PRIORITY
        int "State Machine task priority"
        default 100

config FLIGHTCOMPUTER_STATEMACHINE_STACKSIZE
        int "State Machine stack size"
        default 2048

endif
```

## nuttx/cmake-build-debug/apps/Kconfig
```kconfig
source "/Users/frostydev/workspace/MQP/Vanguard-RTOS/nuttx/cmake-build-debug/apps/_Users_frostydev_workspace_MQP_Vanguard-RTOS_apps_FlightComputer_Kconfig"
source "/Users/frostydev/workspace/MQP/Vanguard-RTOS/nuttx/cmake-build-debug/apps/_Users_frostydev_workspace_MQP_Vanguard-RTOS_apps_benchmarks_Kconfig"
source "/Users/frostydev/workspace/MQP/Vanguard-RTOS/nuttx/cmake-build-debug/apps/_Users_frostydev_workspace_MQP_Vanguard-RTOS_apps_boot_Kconfig"
source "/Users/frostydev/workspace/MQP/Vanguard-RTOS/nuttx/cmake-build-debug/apps/_Users_frostydev_workspace_MQP_Vanguard-RTOS_apps_canutils_Kconfig"
source "/Users/frostydev/workspace/MQP/Vanguard-RTOS/nuttx/cmake-build-debug/apps/_Users_frostydev_workspace_MQP_Vanguard-RTOS_apps_crypto_Kconfig"
source "/Users/frostydev/workspace/MQP/Vanguard-RTOS/nuttx/cmake-build-debug/apps/_Users_frostydev_workspace_MQP_Vanguard-RTOS_apps_examples_Kconfig"
source "/Users/frostydev/workspace/MQP/Vanguard-RTOS/nuttx/cmake-build-debug/apps/_Users_frostydev_workspace_MQP_Vanguard-RTOS_apps_fsutils_Kconfig"
source "/Users/frostydev/workspace/MQP/Vanguard-RTOS/nuttx/cmake-build-debug/apps/_Users_frostydev_workspace_MQP_Vanguard-RTOS_apps_games_Kconfig"
source "/Users/frostydev/workspace/MQP/Vanguard-RTOS/nuttx/cmake-build-debug/apps/_Users_frostydev_workspace_MQP_Vanguard-RTOS_apps_graphics_Kconfig"
source "/Users/frostydev/workspace/MQP/Vanguard-RTOS/nuttx/cmake-build-debug/apps/_Users_frostydev_workspace_MQP_Vanguard-RTOS_apps_industry_Kconfig"
source "/Users/frostydev/workspace/MQP/Vanguard-RTOS/nuttx/cmake-build-debug/apps/_Users_frostydev_workspace_MQP_Vanguard-RTOS_apps_interpreters_Kconfig"
source "/Users/frostydev/workspace/MQP/Vanguard-RTOS/nuttx/cmake-build-debug/apps/_Users_frostydev_workspace_MQP_Vanguard-RTOS_apps_logging_Kconfig"
source "/Users/frostydev/workspace/MQP/Vanguard-RTOS/nuttx/cmake-build-debug/apps/_Users_frostydev_workspace_MQP_Vanguard-RTOS_apps_lte_Kconfig"
source "/Users/frostydev/workspace/MQP/Vanguard-RTOS/nuttx/cmake-build-debug/apps/_Users_frostydev_workspace_MQP_Vanguard-RTOS_apps_math_Kconfig"
source "/Users/frostydev/workspace/MQP/Vanguard-RTOS/nuttx/cmake-build-debug/apps/_Users_frostydev_workspace_MQP_Vanguard-RTOS_apps_mlearning_Kconfig"
source "/Users/frostydev/workspace/MQP/Vanguard-RTOS/apps/modbus/Kconfig"
source "/Users/frostydev/workspace/MQP/Vanguard-RTOS/nuttx/cmake-build-debug/apps/_Users_frostydev_workspace_MQP_Vanguard-RTOS_apps_netutils_Kconfig"
source "/Users/frostydev/workspace/MQP/Vanguard-RTOS/apps/nshlib/Kconfig"
source "/Users/frostydev/workspace/MQP/Vanguard-RTOS/apps/platform/Kconfig"
source "/Users/frostydev/workspace/MQP/Vanguard-RTOS/nuttx/cmake-build-debug/apps/_Users_frostydev_workspace_MQP_Vanguard-RTOS_apps_sdr_Kconfig"
source "/Users/frostydev/workspace/MQP/Vanguard-RTOS/nuttx/cmake-build-debug/apps/_Users_frostydev_workspace_MQP_Vanguard-RTOS_apps_system_Kconfig"
source "/Users/frostydev/workspace/MQP/Vanguard-RTOS/nuttx/cmake-build-debug/apps/_Users_frostydev_workspace_MQP_Vanguard-RTOS_apps_testing_Kconfig"
source "/Users/frostydev/workspace/MQP/Vanguard-RTOS/apps/tools/Kconfig"
source "/Users/frostydev/workspace/MQP/Vanguard-RTOS/nuttx/cmake-build-debug/apps/_Users_frostydev_workspace_MQP_Vanguard-RTOS_apps_wireless_Kconfig"
```
